## layers/meta-general/conf/layer.conf
```bitbake
# We have a conf and classes directory, add to BBPATH
BBPATH .= ":${LAYERDIR}"

# We have recipes-* directories, add to BBFILES
BBFILES += "${LAYERDIR}/recipes-*/*/*.bb \
	${LAYERDIR}/recipes-*/*/*.bbappend"

BBFILE_COLLECTIONS += "meta-general"
BBFILE_PATTERN_meta-general = "^${LAYERDIR}/"
BBFILE_PRIORITY_meta-general = "6"
LAYERSERIES_COMPAT_meta-general = "zeus"
```

## meta-mbed-cloud-client/conf/layer.conf
```bitbake
# We have a conf and classes directory, add to BBPATH
BBPATH .= ":${LAYERDIR}"

# We have recipes-* directories, add to BBFILES
BBFILES += "${LAYERDIR}/recipes-*/*/*.bb \
	${LAYERDIR}/recipes-*/*/*.bbappend"

BBFILE_COLLECTIONS += "meta-mbed-cloud-client"
BBFILE_PATTERN_meta-mbed-cloud-client = "^${LAYERDIR}/"
BBFILE_PRIORITY_meta-mbed-cloud-client = "6"

LICENSE_PATH += "${LAYERDIR}/files/custom-licenses"
```

## meta-mbed-cloud-client/conf/machine/mbed-cloud-client-rpi-machine.conf
```bitbake
#@TYPE: Machine
#@NAME: mbed cloud client machine based on RPi 3
#@DESCRIPTION: Machine configuration for the mbed cloud client device

#Were building on RPi3, so for the convenience, set the machine variable and include its conf
MACHINE = "raspberrypi3"
include conf/machine/raspberrypi3.conf

#Use our custom scard_image -class to overwrite the raspberrypi basic image
IMAGE_CLASSES += " mbed_sdcard_image-rpi "
IMAGE_FSTYPES += " mbed-sdimg "

UBOOT_MACHINE = "rpi_3_32b_config"
```
